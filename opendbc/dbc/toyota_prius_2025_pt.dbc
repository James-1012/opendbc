VERSION ""

NS_ :

BS_:

BU_: XXX EPS

CM_ "Toyota Prius 5th Gen PT minimal DBC for parser isolation";

CM_ BO_ 48 "32-byte PT/body candidate frame";
CM_ BO_ 144 "32-byte PT/body candidate frame";
CM_ BO_ 201 "32-byte PT/body candidate frame";
CM_ BO_ 213 "8-byte status candidate frame";
CM_ BO_ 215 "32-byte PT/body candidate frame";
CM_ BO_ 277 "8-byte PT/body candidate frame";
CM_ BO_ 278 "8-byte PT/body candidate frame";
CM_ BO_ 295 "8-byte PT/body candidate frame";

BO_ 48 PT_STATE_0x030: 32 XXX
 SG_ PT030_BYTE0 : 0|8@1+ (1,0) [0|255] "" XXX

BO_ 144 PT_STATE_0x090: 32 XXX
 SG_ PT090_BYTE0 : 0|8@1+ (1,0) [0|255] "" XXX

BO_ 201 PT_STATE_0x0C9: 32 XXX
 SG_ PT0C9_BYTE0 : 0|8@1+ (1,0) [0|255] "" XXX

BO_ 213 STATUS_0x0D5: 8 XXX
 SG_ ST0D5_BYTE0 : 0|8@1+ (1,0) [0|255] "" XXX

BO_ 215 PT_STATE_0x0D7: 32 XXX
 SG_ PT0D7_BYTE0 : 0|8@1+ (1,0) [0|255] "" XXX

BO_ 277 PT_STATUS_0x115: 8 XXX
 SG_ PT115_BYTE0 : 0|8@1+ (1,0) [0|255] "" XXX

BO_ 278 PT_STATUS_0x116: 8 XXX
 SG_ PT116_BYTE0 : 0|8@1+ (1,0) [0|255] "" XXX

BO_ 295 PT_STATUS_0x127: 8 XXX
 SG_ PT127_BYTE0 : 0|8@1+ (1,0) [0|255] "" XXX
