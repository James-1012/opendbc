VERSION ""

NS_ :

BS_:

BU_: XXX

CM_ "Toyota Prius 5th Gen TSS3 ADAS (CAN-FD) skeleton DBC v1";
CM_ "Raw payload split for reverse engineering. Last 4 bytes assumed CRC/auth candidate.";

# =========================
# TRACK_A (CAN-FD extended)
# =========================

BO_ 392 TRACK_A_FD_8: 64 XXX
 SG_ PAYLOAD_0 : 0|480@0+ (1,0) [0|0] "" XXX
 SG_ TAIL : 480|32@0+ (1,0) [0|4294967295] "" XXX

BO_ 393 TRACK_A_FD_9: 64 XXX
 SG_ PAYLOAD_1 : 0|480@0+ (1,0) [0|0] "" XXX
 SG_ TAIL : 480|32@0+ (1,0) [0|4294967295] "" XXX

BO_ 394 TRACK_A_FD_10: 64 XXX
 SG_ PAYLOAD_2 : 0|480@0+ (1,0) [0|0] "" XXX
 SG_ TAIL : 480|32@0+ (1,0) [0|4294967295] "" XXX

BO_ 395 TRACK_A_FD_11: 64 XXX
 SG_ PAYLOAD_3 : 0|480@0+ (1,0) [0|0] "" XXX
 SG_ TAIL : 480|32@0+ (1,0) [0|4294967295] "" XXX

BO_ 396 TRACK_A_FD_12: 48 XXX
 SG_ PAYLOAD_4 : 0|352@0+ (1,0) [0|0] "" XXX
 SG_ TAIL : 352|32@0+ (1,0) [0|4294967295] "" XXX

# =========================
# TRACK_B (CAN-FD extended)
# =========================

BO_ 416 TRACK_B_FD_0: 48 XXX
 SG_ PAYLOAD_5 : 0|352@0+ (1,0) [0|0] "" XXX
 SG_ TAIL : 352|32@0+ (1,0) [0|4294967295] "" XXX

# =========================
# OBJECT / STATUS (new TSS3?)
# =========================

BO_ 512 OBJECT_FD_0: 64 XXX
 SG_ PAYLOAD_6 : 0|480@0+ (1,0) [0|0] "" XXX
 SG_ TAIL : 480|32@0+ (1,0) [0|4294967295] "" XXX

BO_ 513 OBJECT_FD_1: 64 XXX
 SG_ PAYLOAD_7 : 0|480@0+ (1,0) [0|0] "" XXX
 SG_ TAIL : 480|32@0+ (1,0) [0|4294967295] "" XXX
